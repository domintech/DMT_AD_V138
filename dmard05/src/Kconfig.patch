## dmard08/src/Kconfig.patch
```kconfig
--- Kconfig.old	2012-01-31 10:44:21.343525398 +0800
+++ Kconfig	2012-01-31 10:43:17.146650058 +0800
@@ -550,6 +550,46 @@
 	  If you say yes here you get support for orientation
 	  sensor AS9888.
 
+config SENSORS_DMARD03
+	tristate "DMARD03 GSENSOR support"
+	default n
+	depends on I2C=y
+	---help---
+	  If you say yes here you get support for accelemeter
+	  sensor DMARD03.
+
+config SENSORS_DMARD05
+	tristate "DMARD05 GSENSOR support"
+	default n
+	depends on I2C=y
+	---help---
+	  If you say yes here you get support for accelemeter
+	  sensor DMARD05.
+
+config SENSORS_DMARD06
+	tristate "DMARD06 GSENSOR support"
+	default n
+	depends on I2C=y
+	---help---
+	  If you say yes here you get support for accelemeter
+	  sensor DMARD06.
+
+config SENSORS_DMARD07
+	tristate "DMARD07 GSENSOR support"
+	default n
+	depends on I2C=y
+	---help---
+	  If you say yes here you get support for accelemeter
+	  sensor DMARD07.
+
+config SENSORS_DMARD08
+	tristate "DMARD08 GSENSOR support"
+	default n
+	depends on I2C=y
+	---help---
+	  If you say yes here you get support for accelemeter
+	  sensor DMARD08.
+
 source "drivers/misc/c2port/Kconfig"
 source "drivers/misc/eeprom/Kconfig"
 source "drivers/misc/cb710/Kconfig"
```
